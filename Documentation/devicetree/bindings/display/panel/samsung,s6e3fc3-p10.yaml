## Documentation/devicetree/bindings/display/panel/samsung,s6e3fc3-p10.yaml
```yaml
# SPDX-License-Identifier: GPL-2.0-only OR BSD-2-Clause
%YAML 1.2
---
$id: http://devicetree.org/schemas/display/panel/samsung,s6e3fc3-p10.yaml#
$schema: http://devicetree.org/meta-schemas/core.yaml#

title: Samsung S6E3FC3 P10 AMOLED DSI panel

description:
  The S6E3FC3 is a display driver IC from Samsung Mobile Display. The P10
  panel is its 1080x2400 command-mode AMOLED panel in the Google Pixel 7.
  It takes DSC-compressed pixel data over four MIPI DSI lanes and reports
  its refresh timing on a tearing effect (TE) line.

maintainers:
  - Alejandro Garcia <skipper.pelygro@gmail.com>

allOf:
  - $ref: panel-common.yaml#

properties:
  compatible:
    const: samsung,s6e3fc3-p10

  reg:
    maxItems: 1

  reset-gpios: true

  vddi-supply:
    description: I/O supply

  vci-supply:
    description: Analog supply

required:
  - compatible
  - reg
  - reset-gpios

unevaluatedProperties: false

examples:
  - |
    #include <dt-bindings/gpio/gpio.h>

    dsi {
        #address-cells = <1>;
        #size-cells = <0>;

        panel@0 {
            compatible = "samsung,s6e3fc3-p10";
            reg = <0>;
            reset-gpios = <&gpa7 1 GPIO_ACTIVE_LOW>;
            vddi-supply = <&vddi>;
            vci-supply = <&vci>;
            width-mm = <66>;
            height-mm = <146>;
        };
    };

...
```
